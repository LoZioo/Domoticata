## src/control_unit/components/setup/Kconfig.projbuild
```kconfig
##########################################################################
#	Configurations under "Project configurations" on menuconfig.
#
#	Note:	if you want to store your configuration under "Component config"
# 			on menuconfig, just rename this file "Kconfig".
##########################################################################

menu "Project configurations"

	menu "UART"
		config UART_PORT
			int "RS-485 UART port number"
			range 0 2
			default 1

		config UART_BAUD_RATE
			int "RS-485 UART Baud Rate"
			default 115200

	endmenu

	menu "LEDC"
		config LEDC_PWM_FREQUENCY_HZ
			int "PWM frequency (Hz)"
			default 30000

		config LEDC_BIT_RES
			int "Bit resolution"
			range 1 20
			default 7

	endmenu

	menu "ADC"
		config ADC_SAMPLE_RATE
			int "Sample rate (Hz)"
			range 20000 2000000
			default 20000

		config ADC_SAMPLES
			int "Number samples per channel"
			default 1000

	endmenu

	menu "GPIO mapping"
		config GPIO_UART_TX
			int "RS-485 UART TX"
			default 2

		config GPIO_UART_RX
			int "RS-485 UART RX"
			default 34

		config GPIO_UART_DE_RE
			int "RS-485 UART DE/~RE"
			default 0

		config GPIO_ALARM
			int "Alarm"
			default 14

		config GPIO_FAN
			int "Fan"
			default 33

		config GPIO_TEMP
			int "Temperature"
			default 35

		config GPIO_AC_V
			int "AC voltage"
			default 36

		config GPIO_AC_I
			int "AC current"
			default 39

		config GPIO_LED_1
			int "LED 1"
			default 4

		config GPIO_LED_2
			int "LED 2"
			default 13

		config GPIO_LED_3
			int "LED 3"
			default 16

		config GPIO_LED_4
			int "LED 4"
			default 17

		config GPIO_LED_5
			int "LED 5"
			default 18

		config GPIO_LED_6
			int "LED 6"
			default 19

		config GPIO_LED_7
			int "LED 7"
			default 21

		config GPIO_LED_8
			int "LED 8"
			default 22

		config GPIO_LED_9
			int "LED 9"
			default 23

		config GPIO_LED_10
			int "LED 10"
			default 25

		config GPIO_LED_11
			int "LED 11"
			default 15

		config GPIO_LED_12
			int "LED 12"
			default 5

		config GPIO_RELAY_1
			int "Relay 1"
			default 26

		config GPIO_RELAY_2
			int "Relay 2"
			default 27

		config GPIO_RELAY_3
			int "Relay 3"
			default 32

		config GPIO_RELAY_4
			int "Relay 4"
			default 12

		choice ADC_CHANNEL_V
			prompt "ADC1 AC voltage GPIO"
			default ADC_CHANNEL_V_TO_ADC_CHANNEL_0

			config ADC_CHANNEL_V_TO_ADC_CHANNEL_4
				bool "GPIO32"

			config ADC_CHANNEL_V_TO_ADC_CHANNEL_5
				bool "GPIO33"

			config ADC_CHANNEL_V_TO_ADC_CHANNEL_6
				bool "GPIO34"

			config ADC_CHANNEL_V_TO_ADC_CHANNEL_7
				bool "GPIO35"

			config ADC_CHANNEL_V_TO_ADC_CHANNEL_0
				bool "GPIO36"

			config ADC_CHANNEL_V_TO_ADC_CHANNEL_1
				bool "GPIO37"

			config ADC_CHANNEL_V_TO_ADC_CHANNEL_2
				bool "GPIO38"

			config ADC_CHANNEL_V_TO_ADC_CHANNEL_3
				bool "GPIO39"

		endchoice

		choice ADC_CHANNEL_I
			prompt "ADC1 AC current GPIO"
			default ADC_CHANNEL_I_TO_ADC_CHANNEL_3

			config ADC_CHANNEL_I_TO_ADC_CHANNEL_4
				bool "GPIO32"

			config ADC_CHANNEL_I_TO_ADC_CHANNEL_5
				bool "GPIO33"

			config ADC_CHANNEL_I_TO_ADC_CHANNEL_6
				bool "GPIO34"

			config ADC_CHANNEL_I_TO_ADC_CHANNEL_7
				bool "GPIO35"

			config ADC_CHANNEL_I_TO_ADC_CHANNEL_0
				bool "GPIO36"

			config ADC_CHANNEL_I_TO_ADC_CHANNEL_1
				bool "GPIO37"

			config ADC_CHANNEL_I_TO_ADC_CHANNEL_2
				bool "GPIO38"

			config ADC_CHANNEL_I_TO_ADC_CHANNEL_3
				bool "GPIO39"

		endchoice

		choice ADC_CHANNEL_TEMP
			prompt "ADC1 temperature GPIO"
			default ADC_CHANNEL_TEMP_TO_ADC_CHANNEL_7

			config ADC_CHANNEL_TEMP_TO_ADC_CHANNEL_4
				bool "GPIO32"

			config ADC_CHANNEL_TEMP_TO_ADC_CHANNEL_5
				bool "GPIO33"

			config ADC_CHANNEL_TEMP_TO_ADC_CHANNEL_6
				bool "GPIO34"

			config ADC_CHANNEL_TEMP_TO_ADC_CHANNEL_7
				bool "GPIO35"

			config ADC_CHANNEL_TEMP_TO_ADC_CHANNEL_0
				bool "GPIO36"

			config ADC_CHANNEL_TEMP_TO_ADC_CHANNEL_1
				bool "GPIO37"

			config ADC_CHANNEL_TEMP_TO_ADC_CHANNEL_2
				bool "GPIO38"

			config ADC_CHANNEL_TEMP_TO_ADC_CHANNEL_3
				bool "GPIO39"

		endchoice

	endmenu
endmenu
```

## src/control_unit/main/Kconfig.projbuild
```kconfig
##########################################################################
#	Configurations under "Project configurations" on menuconfig.
#
#	Note:	if you want to store your configuration under "Component config"
# 			on menuconfig, just rename this file to "Kconfig".
##########################################################################

menu "Project configurations"

	menu "RS485"
		config RS485_TASK_STACK_SIZE_BYTES
			int "Task stack max size (bytes)"
			range 2048 8192
			default 4096

		config RS485_TASK_PRIORITY
			int "Task priority"
			range 0 24
			default 0
			help
				0 is equal to `tskIDLE_PRIORITY` (lower priority), while 24 is equal to `configMAX_PRIORITIES` - 1 (higher priority).

		choice RS485_TASK_CORE_AFFINITY
			prompt "Task core affinity"
			default RS485_TASK_CORE_AFFINITY_APPLICATION

			config RS485_TASK_CORE_AFFINITY_PROTOCOL
				bool "Protocol core (0)"

			config RS485_TASK_CORE_AFFINITY_APPLICATION
				bool "Application core (1)"

		endchoice

		config RS485_TASK_CORE_AFFINITY
			int
			default 0 if RS485_TASK_CORE_AFFINITY_PROTOCOL
			default 1 if RS485_TASK_CORE_AFFINITY_APPLICATION

		config RS485_UART_PORT
			int "UART port number"
			range 0 2
			default 1

		config RS485_UART_BAUD_RATE
			int "UART Baud Rate"
			default 115200

	endmenu

	menu "PWM"
		config PWM_TASK_STACK_SIZE_BYTES
			int "Task stack max size (bytes)"
			range 2048 8192
			default 4096

		config PWM_TASK_PRIORITY
			int "Task priority"
			range 0 24
			default 0
			help
				0 is equal to `tskIDLE_PRIORITY` (lower priority), while 24 is equal to `configMAX_PRIORITIES` - 1 (higher priority).

		choice PWM_TASK_CORE_AFFINITY
			prompt "Task core affinity"
			default PWM_TASK_CORE_AFFINITY_APPLICATION

			config PWM_TASK_CORE_AFFINITY_PROTOCOL
				bool "Protocol core (0)"

			config PWM_TASK_CORE_AFFINITY_APPLICATION
				bool "Application core (1)"

		endchoice

		config PWM_TASK_CORE_AFFINITY
			int
			default 0 if PWM_TASK_CORE_AFFINITY_PROTOCOL
			default 1 if PWM_TASK_CORE_AFFINITY_APPLICATION

		config PWM_FREQUENCY_HZ
			int "PWM frequency (Hz)"
			default 500

	endmenu

	menu "PowerMonitor"
		config PM_TASK_STACK_SIZE_BYTES
			int "Task stack max size (bytes)"
			range 2048 8192
			default 4096

		config PM_TASK_PRIORITY
			int "Task priority"
			range 0 24
			default 0
			help
				0 is equal to `tskIDLE_PRIORITY` (lower priority), while 24 is equal to `configMAX_PRIORITIES` - 1 (higher priority).

		choice PM_TASK_CORE_AFFINITY
			prompt "Task core affinity"
			default PM_TASK_CORE_AFFINITY_APPLICATION

			config PM_TASK_CORE_AFFINITY_PROTOCOL
				bool "Protocol core (0)"

			config PM_TASK_CORE_AFFINITY_APPLICATION
				bool "Application core (1)"

		endchoice

		config PM_TASK_CORE_AFFINITY
			int
			default 0 if PM_TASK_CORE_AFFINITY_PROTOCOL
			default 1 if PM_TASK_CORE_AFFINITY_APPLICATION

		config PM_ADC_SAMPLE_RATE
			int "Sample rate (Hz)"
			range 20000 2000000
			default 20000

		config PM_ADC_SAMPLES
			int "Number of samples per channel"
			default 4000

	endmenu

	menu "Webserver"
		config WEBSERVER_TASK_STACK_SIZE_BYTES
			int "Task stack max size (bytes)"
			range 2048 8192
			default 4096

		config WEBSERVER_TASK_PRIORITY
			int "Task priority"
			range 0 24
			default 0
			help
				0 is equal to `tskIDLE_PRIORITY` (lower priority), while 24 is equal to `configMAX_PRIORITIES` - 1 (higher priority).

		choice WEBSERVER_TASK_CORE_AFFINITY
			prompt "Task core affinity"
			default WEBSERVER_TASK_CORE_AFFINITY_APPLICATION

			config WEBSERVER_TASK_CORE_AFFINITY_PROTOCOL
				bool "Protocol core (0)"

			config WEBSERVER_TASK_CORE_AFFINITY_APPLICATION
				bool "Application core (1)"

		endchoice

		config WEBSERVER_TASK_CORE_AFFINITY
			int
			default 0 if WEBSERVER_TASK_CORE_AFFINITY_PROTOCOL
			default 1 if WEBSERVER_TASK_CORE_AFFINITY_APPLICATION

		config WEBSERVER_LISTEN_PORT
			int "Webserver listen port"
			range 0 65535
			default 80

		config WEBSERVER_VFS_ROOT_FOLDER
			string "Root folder on VFS"
			default "/www"

		config WEBSERVER_FILE_LINE_BUFFER_LEN_BYTES
			int "File line buffer length (bytes)"
			default 1024

		config WEBSERVER_QUERY_VAL_BUFFER_LEN_BYTES
			int "HTTP query value buffer length (bytes)"
			default 100
			help
				Needed to allocate a buffer for reading a value of
				a given key in an HTTP URL query string.

	endmenu

	menu "OTA update"
		config OTA_HTTP_SERVER_IP_ADDR
			string "HTTP server IP address"
			default "192.168.1.2"

		config OTA_HTTP_SERVER_PORT
			int "HTTP server port"
			default 5500

		config OTA_HTTP_BINARY_FILE_PATH
			string "Binary file path (without ending '/')"
			default "/build"

		config OTA_FS_BINARY_FILE_NAME
			string "Filesystem binary file name (without \".bin\" extension)"
			default "fs_0"

		config OTA_FW_BINARY_FILE_NAME
			string "Firmware binary file name (without \".bin\" extension)"
			default "control_unit"

		config OTA_BUFFER_LEN_BYTES
			int "OTA buffer length (bytes)"
			default 1024

	endmenu

	menu "Wi-Fi"
		config WIFI_STA_CONNECTION_TIMEOUT_SECONDS
			int "Maximum connection time to saved Wi-Fi network (seconds)"
			range 3 30
			default 10

	endmenu

	menu "GPIO mapping"
		config GPIO_UART_TX
			int "RS-485 UART TX"
			default 2

		config GPIO_UART_RX
			int "RS-485 UART RX"
			default 34

		config GPIO_UART_DE_RE
			int "RS-485 UART DE/~RE"
			default 0

		config GPIO_ALARM
			int "Alarm"
			default 14

		config GPIO_FAN
			int "Fan"
			default 33

		config GPIO_TEMP
			int "Temperature"
			default 35

		config GPIO_AC_V
			int "AC voltage"
			default 36

		config GPIO_AC_I
			int "AC current"
			default 39

		config GPIO_LED_1
			int "LED 1"
			default 4

		config GPIO_LED_2
			int "LED 2"
			default 13

		config GPIO_LED_3
			int "LED 3"
			default 16

		config GPIO_LED_4
			int "LED 4"
			default 17

		config GPIO_LED_5
			int "LED 5"
			default 18

		config GPIO_LED_6
			int "LED 6"
			default 19

		config GPIO_LED_7
			int "LED 7"
			default 21

		config GPIO_LED_8
			int "LED 8"
			default 22

		config GPIO_LED_9
			int "LED 9"
			default 23

		config GPIO_LED_10
			int "LED 10"
			default 25

		config GPIO_LED_11
			int "LED 11"
			default 15

		config GPIO_LED_12
			int "LED 12"
			default 5

		config GPIO_RELAY_1
			int "Relay 1"
			default 26

		config GPIO_RELAY_2
			int "Relay 2"
			default 27

		config GPIO_RELAY_3
			int "Relay 3"
			default 32

		config GPIO_RELAY_4
			int "Relay 4"
			default 12

	endmenu
endmenu
```
